MEMORY
{
	FLASH : ORIGIN = 0x00000000, LENGTH = 16K
	RAM : ORIGIN = 0x20000000, LENGTH = 2K
}

_HART_STACK_SIZE = 512;
_HART_COUNT = 1;

_EXCEPTION_AND_INTERRUPT_VECTOR_TABLE_BASE_ADDR = ORIGIN ( FLASH );

INCLUDE sherbet/layout.ld
